## config/boards/shields/lumen/Kconfig.defconfig
```kconfig
if SHIELD_LUMEN_LEFT

config ZMK_KEYBOARD_NAME
    default "Lumen"

config ZMK_SPLIT_ROLE_CENTRAL
    default y

endif

if SHIELD_LUMEN_LEFT || SHIELD_LUMEN_RIGHT

config ZMK_SPLIT
    default y

endif
```

## config/boards/shields/lumen/Kconfig.shield
```kconfig
# Copyrigh (c) 2020 Pete Johanson
# SPDX-License-Identifier: MIT

config SHIELD_LUMEN_LEFT
    def_bool $(shields_list_contains,lumen_left)

config SHIELD_LUMEN_RIGHT
    def_bool $(shields_list_contains,lumen_right)
```
